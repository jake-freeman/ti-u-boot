## configs/am62x_lpsk_a53_defconfig
```kconfig
#include <configs/am62x_evm_a53_defconfig>
CONFIG_DEFAULT_DEVICE_TREE="k3-am62-lp-sk"
CONFIG_SPL_MTD=y
CONFIG_SPL_MTD_LOAD=y
CONFIG_SYS_MTD_U_BOOT_OFFS=0x280000
CONFIG_SPL_NAND_SPI_SUPPORT=y
CONFIG_CMD_MTD=y
CONFIG_SPL_DM_DEVICE_REMOVE=y
CONFIG_DM_MTD=y
CONFIG_MTD_SPI_NAND=y
CONFIG_SYS_NAND_BLOCK_SIZE=0x40000
CONFIG_SYS_NAND_PAGE_COUNT=0x40
CONFIG_SYS_NAND_PAGE_SIZE=0x1000
CONFIG_SYS_NAND_OOBSIZE=0x100
CONFIG_SYS_NAND_MAX_CHIPS=1
CONFIG_SYS_NAND_SELF_INIT=y
# CONFIG_SPL_NAND_AM33XX_BCH is not set
CONFIG_SYS_NAND_U_BOOT_OFFS=0x600000
CONFIG_SYS_NAND_U_BOOT_LOCATIONS=y
CONFIG_NAND_BOOT=y
CONFIG_SPL_NAND_SUPPORT=y
CONFIG_SPL_NAND_DRIVERS=y
CONFIG_SPL_NAND_ECC=y
CONFIG_SPL_NAND_BASE=y
CONFIG_SPL_NAND_IDENT=y
CONFIG_CMD_UBI=y
CONFIG_CMD_NAND=y
CONFIG_TI_GPMC=y
CONFIG_CMD_MTDPARTS=y
CONFIG_MTD_RAW_NAND=y
CONFIG_NAND_OMAP_GPMC=y
CONFIG_NAND_OMAP_ELM=y
CONFIG_MEMORY=y
CONFIG_SPL_MEMORY=y
CONFIG_DM_I2C_GPIO=y
CONFIG_DFU_MTD=y
CONFIG_DFU_NAND=y
CONFIG_DFU_NAND_TRIMFFS=y
CONFIG_SYS_DFU_DATA_BUF_SIZE=0x40000
```
